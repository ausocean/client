## esp/esp/main/Kconfig.projbuild
```kconfig
menu "SD Card"

    config SD_MISO
        int "SPI MISO Pin number"
        range 1 255
        default 12
        help
            Set the GPIO pin used as Master In for the SD card.


    config SD_MOSI
        int "SPI MOSI Pin number"
        range 1 255
        default 13
        help
            Set the GPIO pin used as Master Out for the SD card.


    config SD_CLK
        int "SPI CLK Pin number"
        range 1 255
        default 14
        help
            Set the GPIO pin used as Clock for the SD card.


    config SD_CS
        int "SPI CS Pin number"
        range 1 255
        default 15
        help
            Set the GPIO pin used as Chip Select for the SD card.


    config SD_DET
        int "SD detect Pin number"
        range 1 255
        default 5
        help
            Set the GPIO pin used as SD detect for the SD card.

    config SD_QUADWP
        int "Write Protect Pin number"
        range -1 255
        default -1
        help
            GPIO pin for WP (Write Protect) signal, or -1 if not used.

    config SD_QUADHD
        int "Hold Signal Pin number"
        range -1 255
        default -1
        help
            GPIO pin for HD (Hold) signal, or -1 if not used.

    config SD_MAX_TRANSFER_SZ
        int "Max Transfer Size"
        range 1 32000
        default 4000
        help
            Maximum transfer size, in bytes. Defaults to 4092 if 0 when DMA enabled, or to SOC_SPI_MAXIMUM_BUFFER_SIZE if DMA is disabled.

endmenu
menu "Amplifier"

    config AMP_I2C_ADDRESS
    int "AMP I2C Address"
    range 0 127
    # The default amp address is 0x2D (45)
    default 45 
    help
        I2C address of the attached Amplifier.

    config AMP_I2C_PORT
    int "I2C Port Number"
    range 0 1
    default 0
    help
        Port number to communicate with the Amplifier I2C interface.

    config AMP_I2C_CLOCK_SPEED
    int "I2C Clock Speed (Hz)"
    range 1000 250000
    default 0
    help
        Clock speed used by the I2C bus to communicate with the amplifier.

    config AMP_I2C_SDA
    int "I2C SDA GPIO pin number"
    range 1 255
    default 16
    help
        SDA Pin GPIO number.

    config AMP_I2C_SCL
    int "I2C SCL GPIO pin number"
    range 1 255
    default 18
    help
        SCL Pin GPIO number.

endmenu
```

## esp/speaker-netsender/components/netsender/Kconfig.projbuild
```kconfig
menu "Netsender"

    config NETSENDER_MAX_PINS
        int "Maximum supported pins"
        range 1 255
        default 20
        help
            The number of pins supported by the hardware and firmware.

    config NETSENDER_DKEY_SIZE
        int "Device Key length"
        range 10 32
        default 32
        help
            The number of digits in the device key.

    config NETSENDER_RESERVED_SIZE
        int "Reserved bytes in Config"
        range 0 255
        default 104
        help
            The number of reserved bytes in the config struct. This should
            be kept at a value that makes the total config size be a multiple
            of 128 bytes.

endmenu
```
